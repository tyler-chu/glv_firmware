#ifndef LCD_CONFIG
#define LCD_CONFIG

#include <Wire.h>
#include <Arduino.h>
/*
  Key for LCD Connectors:
  Pin 1 (Black) = GND (VSS)
  Pin 2 (RED) = VDD (3.3V) w/ volt divider
  Pin 3 (BLUE) = SDA (37)
  Pin 4 (YELLOW) = SCL (35)
  Pin 5 (PURPLE) = A0 (19)
  Pin 6 (WHITE) = RST (21)
  Pin 7 (WHITE/PURPLE) = CS1B (33)
  Pin 8 (RED) = LED+ w/ volt divider
*/ 
#define RES 21  // reset signal           
#define CS 33   // chip select signal              
#define RS 19   // register select signal (A0)    
#define SC 35   // serial clock signal            
#define SI 37   // serial data signal  

// hexadecimal representation of UI Bitmap
unsigned char bms_ui[] = {
  0x00, 0x06, 0x06, 0xFE, 0xFE, 0x06, 0x06, 0x00, 0x00, 0xFE, 0xFE, 0xD6, 0xD6, 0xD6, 0xD6, 0x00,  // T E
  0x00, 0xFE, 0x0C, 0x38, 0x38, 0x0C, 0xFE, 0x00, 0x00, 0xFE, 0xFE, 0x36, 0x36, 0x3E, 0x3E, 0x00,  // M P 
  0x00, 0x24, 0x00, 0x00, 0x00, 0x00, 0x00, 0x00, 0x00, 0x00, 0x00, 0x00, 0x00, 0x00, 0x00, 0x00,  // : 
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  0x00, 0x00, 0x00, 0x00, 0x00, 0x00, 0x00, 0x00, 0x00, 0x00, 0x00, 0x00, 0x00, 0x00, 0x00, 0x00, // end of 4th LCD "row"
};
unsigned char bms_ui_values[] = {
  0x00, 0x06, 0x06, 0xFE, 0xFE, 0x06, 0x06, 0x00, 0x00, 0xFE, 0xFE, 0xD6, 0xD6, 0xD6, 0xD6, 0x00,  // T E
  0x00, 0xFE, 0x0C, 0x38, 0x38, 0x0C, 0xFE, 0x00, 0x00, 0xFE, 0xFE, 0x36, 0x36, 0x3E, 0x3E, 0x00,  // M P 
  0x00, 0x24, 0x00, 0x00, 0x00, 0x00, 0x00, 0x00, 0x00, 0x00, 0x00, 0x00, 0x00, 0x00, 0x00, 0x00,  // : 
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  0x00, 0x00, 0x00, 0x00, 0x00, 0x00, 0x00, 0x00, 0x00, 0x00, 0x00, 0x00, 0x00, 0x00, 0x00, 0x00, // end of 4th LCD "row"
};
unsigned char motorvator_upside_down[] = {
// 'Logo - monochrome invert No Watermark', 128x32px
0xff, 0xff, 0xff, 0xff, 0xff, 0xff, 0xff, 0xff, 0xff, 0xff, 0xff, 0xff, 0xff, 0xff, 0xff, 0xff, 
0xff, 0xff, 0xff, 0xff, 0xff, 0xff, 0xff, 0xff, 0xff, 0xff, 0xff, 0xff, 0xff, 0xff, 0xff, 0xff, 
0xff, 0xff, 0xff, 0xff, 0xff, 0xff, 0xff, 0xff, 0xff, 0xff, 0xff, 0xff, 0xff, 0xff, 0xff, 0xff, 
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0xff, 0xff, 0xff, 0xff, 0xff, 0xff, 0xff, 0xff, 0xff, 0xff, 0xff, 0xff, 0xff, 0xff, 0xff, 0xff
};
// data_write(): write physical data to LCD screen
void data_write(unsigned char d)
{
  digitalWrite(CS, LOW);
  digitalWrite(RS, HIGH); // AO = 1 for writing data
  for (unsigned int n = 0; n < 8; n++)
  {
    if ((d & 0x80) == 0x80)
      digitalWrite(SI, HIGH);
    else
      digitalWrite(SI, LOW);
    while (0);
    d = (d << 1);
    digitalWrite(SC, LOW);
    while (0);
    digitalWrite(SC, HIGH);
    while (0);
    digitalWrite(SC, LOW);
  }
  digitalWrite(CS, HIGH);
}

// comm_write(): write command/instruction to LCD screen
void comm_write(unsigned char d) 
{
  digitalWrite(CS, LOW);
  digitalWrite(RS, LOW);
  for (unsigned int n = 0; n < 8; n++)
  {
    if ((d & 0x80) == 0x80)
      digitalWrite(SI, HIGH);
    else
      digitalWrite(SI, LOW);
    while (0);
    d = (d << 1);
    digitalWrite(SC, LOW);
    while (0);
    digitalWrite(SC, HIGH);
    while (0);
    digitalWrite(SC, LOW);
  }
  digitalWrite(CS, HIGH);
}

// disp_pic(): displays input hexadecimal bitmap array (graphic)
void disp_pic(unsigned char *lcd_string)
{
  unsigned char page = 0xB0;
  comm_write(0xAE); // Display OFF
  comm_write(0x40); // Display start address + 0x40
  for (unsigned int i = 0; i < 4; i++)
  {                   // 32pixel display / 8 pixels per page = 4 pages
    comm_write(page); // send page address
    comm_write(0x10); // column address upper 4 bits + 0x10
    comm_write(0x00); // column address lower 4 bits + 0x00
    for (unsigned int j = 0; j < 128; j++)
    {                          // 128 columns wide
      data_write(*lcd_string); // send picture data
      lcd_string++;
    }
    page++; // after 128 columns, go to next page
  }
  comm_write(0xAF);
}

// clear_pic(): removes picture from LCD screen
void clear_lcd(unsigned char *lcd_string)
{
  unsigned char page = 0xB0;
  comm_write(0xAE); // Display OFF
  comm_write(0x40); // Display start address + 0x40
  for (unsigned int i = 0; i < 4; i++)
  {                   // 32pixel display / 8 pixels per page = 4 pages
    comm_write(page); // send page address
    comm_write(0x10); // column address upper 4 bits + 0x10
    comm_write(0x00); // column address lower 4 bits + 0x00
    for (unsigned int j = 0; j < 128; j++)
    {                   // 128 columns wide
      data_write(0x00); // send picture data
      lcd_string++;
    }
    page++; // after 128 columns, go to next page
  }
  comm_write(0xAF);
}

// lcd_setup(): configures required pins as OUTPUT, uses comm_write() to set display settings
void lcd_setup(){
    Serial.println("lcd_setup(): Running...");

    pinMode(RES, OUTPUT); // configure RES as output
    pinMode(CS, OUTPUT);  // configure CS as output
    pinMode(RS, OUTPUT);  // configure RS as output
    pinMode(SC, OUTPUT);  // configure SC as output
    pinMode(SI, OUTPUT);  // configure SI as output
    digitalWrite(RES, LOW);
    delay(100);
    digitalWrite(RES, HIGH);
    delay(100);

    comm_write(0xA0); // ADC select
    comm_write(0xAE); // Display OFF
    comm_write(0xC8); // COM direction scan
    comm_write(0xA2); // LCD bias set
    comm_write(0x2F); // Power Control set
    comm_write(0x21); // Resistor Ratio Set
    comm_write(0x81); // Electronic Volume Command (set contrast) Double Btye: 1 of 2
    comm_write(0x20); // Electronic Volume value (contrast value) Double Byte: 2 of 2
    comm_write(0xAF); // Display ON
}

// lcd_display_ui(): calls disp_pic helper function
void lcd_display_ui(){
  delay(10);
  Serial.println("lcd_display_ui: Running...");
  disp_pic(bms_ui_values);
}

// lcd_clear_ui(): calls clear_lcd helper function
void lcd_clear_ui(){
  delay(10);
  clear_lcd(bms_ui);
}

void lcd_display_motorvator(){
  delay(10);
  Serial.println("lcd_display_motorvator: Running...");
  disp_pic(motorvator_upside_down);
}

#endif



